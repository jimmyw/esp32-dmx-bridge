## main/Kconfig.projbuild
```kconfig
menu "DMX Bridge"

    config DMX_TX_PIN
        int "Default DMX TX GPIO (to RS485 module TXD/DI)"
        default 17

    config DMX_DE_PIN
        int "Default RS485 DE/RE GPIO (-1 = auto-direction module)"
        default -1

    config DMX_UART_NUM
        int "UART used for DMX"
        range 1 2
        default 1

    config DMX_AP_PASSWORD
        string "Provisioning AP password (empty = open, else >= 8 chars)"
        default "dmxbridge"

    config DMX_HOSTNAME_PREFIX
        string "Hostname prefix (MAC suffix is appended)"
        default "dmx-bridge"

    config DMX_RESET_GPIO
        int "Factory-reset button GPIO (hold 5 s)"
        default 0

    config DMX_LED_PIN
        int "Default status LED GPIO (-1 = none)"
        default -1

    config DMX_MIC_SCK_PIN
        int "INMP441 microphone SCK GPIO (-1 = none)"
        range -1 48
        default 4

    config DMX_MIC_WS_PIN
        int "INMP441 microphone WS GPIO (-1 = none)"
        range -1 48
        default 5

    config DMX_MIC_SD_PIN
        int "INMP441 microphone SD GPIO (-1 = none)"
        range -1 48
        default 6

    config DMX_RGB_LED_PIN
        int "Addressable RGB LED (WS2812) GPIO for the beat blink (-1 = none)"
        range -1 48
        default 48
        help
            Flashes on every beat of the microphone analysis. Most ESP32-S3 boards have it on
            GPIO 48 (DevKitC-1 v1.1: GPIO 38); some only connect it once their "RGB" solder
            jumper is bridged. Test it with `rgbled 255 255 255` on the serial console.

endmenu
```
